## Napredni operativni sistemi/Drugi projekat/build/Kconfig/Kconfig.modules
```kconfig
menu "hal_nordic (/home/danilo/zephyrproject/modules/hal/nordic)"
osource "$(ZEPHYR_HAL_NORDIC_KCONFIG)"
config ZEPHYR_HAL_NORDIC_MODULE
	bool
	default y
endmenu
menu "sof (/home/danilo/zephyrproject/modules/audio/sof)"
osource "/home/danilo/zephyrproject/modules/audio/sof/zephyr/Kconfig"
config ZEPHYR_SOF_MODULE
	bool
	default y
endmenu
```

## Napredni operativni sistemi/Drugi projekat/build/Kconfig/Kconfig.shield
```kconfig
osource "/home/danilo/zephyrproject/zephyr/boards/shields/*/Kconfig.shield"
osource "/home/danilo/zephyrproject/zephyr/boards/shields/*/Kconfig.shield"
```

## Napredni operativni sistemi/Drugi projekat/build/Kconfig/Kconfig.shield.defconfig
```kconfig
osource "/home/danilo/zephyrproject/zephyr/boards/shields/*/Kconfig.defconfig"
osource "/home/danilo/zephyrproject/zephyr/boards/shields/*/Kconfig.defconfig"
```

## Napredni operativni sistemi/Drugi projekat/build/Kconfig/Kconfig.soc.arch
```kconfig
osource "/home/danilo/zephyrproject/zephyr/soc/$(ARCH)/Kconfig"
osource "/home/danilo/zephyrproject/zephyr/soc/$(ARCH)/*/Kconfig"
```
